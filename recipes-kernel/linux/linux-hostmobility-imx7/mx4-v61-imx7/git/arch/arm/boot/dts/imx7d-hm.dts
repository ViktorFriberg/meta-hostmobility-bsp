/*
 * Copyright 2016 Toradex AG
 *
 * This program is free software; you can redistribute it and/or modify
 * it under the terms of the GNU General Public License as published by
 * the Free Software Foundation; either version 2 of the License, or
 * (at your option) any later version.
 */

/dts-v1/;
lude "imx7d-colibri.dtsi"
#include "imx7-mx4-v61.dtsi"

 {

	model = "Toradex Colibri iMX7D on Colibri Evaluation Board V3";
	compatible = "hostmobility,imx7d-mx4_v61", "hostmobility,imx7d-mx4_v61", "fsl,imx7d";
			 
	chosen {
		bootargs = "ubi.mtd=ubi root=ubi0:rootfs rw rootfstype=ubifs ubi.fm_autoconvert=1 mtdparts=gpmi-nand:512k(mx7-bcb),1536k(u-boot1)ro,1536k(u-boot2)ro,512k(u-boot-env),8192k(kernel),-(ubi) console=ttymxc0,115200n8 consoleblank=0 viktor=rocks";
	};

	asjdghasdbasnbdasmnb
};

&usbotg2 {
	vbus-supply = <&reg_usbh_vbus>;
	status = "okay";
};
